## CMakeLists.txt
```
cmake_minimum_required(VERSION 3.20)
find_package(Zephyr REQUIRED HINTS $ENV{ZEPHYR_BASE})
project(aimtrk_unit)

set(AIMTRK ${CMAKE_CURRENT_SOURCE_DIR}/../../aimtrk)

target_include_directories(app PRIVATE src ${AIMTRK}/include)

target_sources(app PRIVATE
	src/test_centroid.c
	src/test_detect.c
	src/test_geom.c
	src/test_calib.c
	src/test_zero.c
	src/test_proto.c
	src/test_timesync.c
	src/test_track.c
	src/test_match.c
	${AIMTRK}/src/linalg.c
	${AIMTRK}/src/centroid.c
	${AIMTRK}/src/detect.c
	${AIMTRK}/src/geom.c
	${AIMTRK}/src/calib.c
	${AIMTRK}/src/zero.c
	${AIMTRK}/src/proto.c
	${AIMTRK}/src/timesync.c
	${AIMTRK}/src/track.c
	${AIMTRK}/src/match.c
)
```

## prj.conf
```kconfig
CONFIG_ZTEST=y
# The calibration fit works on the stack (calib.h: under 8 kB)
CONFIG_ZTEST_STACK_SIZE=16384
CONFIG_CBPRINTF_FP_SUPPORT=y
```

## src/proto_vectors.h
```c
/* GENERATED by protocol/gen_vectors.py from protocol/tracker.dbc. Do not edit. */
#ifndef AIMTRK_PROTO_VECTORS_H_
#define AIMTRK_PROTO_VECTORS_H_

#include <stdint.h>

/* HIT_N1 (ID 0x501): {"shot_no": 1234, "x_mm": 812.25, "y_mm": -403.5, "result": 0, "quality": 87, "latency": 14.3} */
static const uint8_t VEC_HIT_OK[8] = {0xD2, 0x04, 0xB1, 0x8C, 0x6C, 0x0E, 0x57, 0x8F};

/* HIT_N1 (ID 0x501): {"shot_no": 65535, "x_mm": -2048, "y_mm": 2047.75, "result": 2, "quality": 255, "latency": 25.5} */
static const uint8_t VEC_HIT_NEG_EDGE[8] = {0xFF, 0xFF, 0x00, 0xE0, 0xFF, 0x27, 0xFF, 0xFF};

/* HIT_N1 (ID 0x501): {"shot_no": 7, "x_mm": 0, "y_mm": 0, "result": 5, "quality": 0, "latency": 0.1} */
static const uint8_t VEC_HIT_DROPPED[8] = {0x07, 0x00, 0x00, 0x00, 0x00, 0x50, 0x00, 0x01};

/* AIM_N1 (ID 0x581): {"frame_seq": 40000, "x_mm": -1499.75, "y_mm": 844.5} */
static const uint8_t VEC_AIM[6] = {0x40, 0x9C, 0x91, 0xA8, 0x4C, 0x03};

/* TRK_STATUS (ID 0x67E): {"fps_x10": 99.9, "dropped": 3, "worst_ms": 1.9, "ambient": 16, "cal_age_h": 5, "faults": 36} */
static const uint8_t VEC_STATUS[7] = {0xE7, 0x03, 0x03, 0x13, 0x10, 0x05, 0x24};

/* SYNC (ID 0x080): {"isotp_pci": 4, "lane_time_us": 4000000123} */
static const uint8_t VEC_SYNC[5] = {0x04, 0x7B, 0x28, 0x6B, 0xEE};

/* SHOT_EVENT_N1 (ID 0x101): {"shot_no": 513, "t_us": 3000000007, "mode": 2, "chambered": 1, "rounds_left": 29} */
static const uint8_t VEC_SHOT_EVENT[8] = {0x01, 0x02, 0x07, 0x5E, 0xD0, 0xB2, 0x06, 0x1D};

/* SHOT_DETAIL_N1 (ID 0x181): {"shot_no": 513, "takeup_ms": 120, "squeeze_ms": 1020, "jerk": 17, "muzzle_rate": 9, "cant": -12, "flinch": -1.3} */
static const uint8_t VEC_SHOT_DETAIL[8] = {0x01, 0x02, 0x1E, 0xFF, 0x11, 0x09, 0xF4, 0xF3};

#endif /* AIMTRK_PROTO_VECTORS_H_ */
```

## src/test_calib.c
```c
/*
 * SPEC F05, §6.4, P06: grid ordering, the calibration fit, hold-out check,
 * and refusal of bad grids (the previous calibration stays in use).
 */
#include <math.h>
#include <zephyr/ztest.h>

#include "aimtrk/calib.h"
#include "test_scene.h"
#include "test_util.h"

#define NG (TS_COLS * TS_ROWS)

ZTEST_SUITE(calib, NULL, NULL, NULL, NULL, NULL);

static double grid[2 * NG];
static double dots[2 * (NG + 8)];
static at_geom truth;
/* The calibration assumes the data-sheet focal length and the sensor centre (both a little off). */
static const at_lens nominal = {.f = 1590.0, .cx = 636.0, .cy = 402.0};

/* Image positions of the grid through the true geometry, with noise; returns the dot count. */
static int make_dots(double noise_px, uint32_t seed)
{
	at_lens l = TS_LENS;
	at_h33 h;

	ts_camera_h(&h);
	zassert_ok(at_geom_init(&truth, &l, &h, TS_SCREEN_W, TS_SCREEN_H));
	ts_grid(grid);
	for (int i = 0; i < NG; i++) {
		zassert_true(at_geom_to_image(&truth, grid[2 * i], grid[(2 * i) + 1], &dots[2 * i],
					      &dots[(2 * i) + 1]));
		dots[2 * i] += noise_px * tu_randn(&seed);
		dots[(2 * i) + 1] += noise_px * tu_randn(&seed);
	}
	return NG;
}

/* Largest screen error of a geometry against the truth, over the screen and its border. */
static double worst_mm(const at_geom *g)
{
	double worst = 0.0;

	for (int i = -10; i <= 10; i++) {
		for (int j = -6; j <= 6; j++) {
			double u, v, x, y;
			double px = 148.0 * i;
			double py = 139.0 * j;

			zassert_true(at_geom_to_image(&truth, px, py, &u, &v));
			zassert_not_equal(at_geom_to_screen(g, u, v, &x, &y), AT_GEOM_FAIL);
			worst = fmax(worst, hypot(x - px, y - py));
		}
	}
	return worst;
}

ZTEST(calib, test_fit_noise_free)
{
	at_calib_cfg cfg;
	at_calib_report rep;
	at_geom g;

	at_calib_cfg_default(&cfg);
	int n = make_dots(0.0, 1U);

	zassert_equal(at_calib_run(dots, n, grid, NG, &nominal, &cfg, TS_SCREEN_W, TS_SCREEN_H, &g, &rep),
		      AT_CAL_OK);
	TC_PRINT("noise-free: fit %.5f px, held-out %.5f px, %d iterations, worst %.4f mm\n",
		 rep.fit_rms_px, rep.holdout_rms_px, rep.iterations, worst_mm(&g));
	zassert_equal(rep.n_found, NG);
	zassert_equal(rep.n_holdout, 10, "every 5th of 54");
	zassert_equal(rep.n_fit, 44);
	/* The nominal focal length and principal point are off; the fit absorbs it. */
	zassert_true(rep.fit_rms_px < 0.01, "%f", rep.fit_rms_px);
	zassert_true(rep.holdout_rms_px < 0.01, "%f", rep.holdout_rms_px);
	zassert_true(worst_mm(&g) < 0.05);
}

/* 0.05 px dot noise: residuals at the noise level, the held-out points close to it. */
ZTEST(calib, test_fit_with_noise)
{
	at_calib_cfg cfg;
	at_calib_report rep;
	at_geom g;

	at_calib_cfg_default(&cfg);
	int n = make_dots(0.05, 2U);

	zassert_equal(at_calib_run(dots, n, grid, NG, &nominal, &cfg, TS_SCREEN_W, TS_SCREEN_H, &g, &rep),
		      AT_CAL_OK);
	TC_PRINT("0.05 px noise: fit %.4f px, held-out %.4f px, worst %.3f mm\n", rep.fit_rms_px,
		 rep.holdout_rms_px, worst_mm(&g));
	zassert_within(rep.fit_rms_px, 0.05 * sqrt(2.0) * sqrt((88.0 - 12.0) / 88.0), 0.02);
	zassert_true(rep.holdout_rms_px < 0.12);
	/* Beyond the grid (the screen corners) the fit extrapolates: the worst point is there. */
	zassert_true(worst_mm(&g) < 1.0);
}

/* Dots in any order, plus spurious detections away from the grid: same result. */
ZTEST(calib, test_order_shuffled_with_extras)
{
	at_calib_cfg cfg;
	at_calib_report rep, rep2;
	at_geom g, g2;
	uint32_t seed = 77U;
	int n = make_dots(0.0, 3U);

	at_calib_cfg_default(&cfg);
	zassert_equal(at_calib_run(dots, n, grid, NG, &nominal, &cfg, TS_SCREEN_W, TS_SCREEN_H, &g, &rep),
		      AT_CAL_OK);
	for (int i = n - 1; i > 0; i--) {
		int j = (int)(tu_rand(&seed) % (uint32_t)(i + 1));
		double tx = dots[2 * i], ty = dots[(2 * i) + 1];

		dots[2 * i] = dots[2 * j];
		dots[(2 * i) + 1] = dots[(2 * j) + 1];
		dots[2 * j] = tx;
		dots[(2 * j) + 1] = ty;
	}
	/* Halfway between grid columns: outside every gate, inside the grid's extent. */
	for (int k = 0; k < 4; k++) {
		double u, v;

		zassert_true(at_geom_to_image(&truth, -1181.25 + (675.0 * k), 450.0 - (200.0 * k), &u, &v));
		dots[2 * (n + k)] = u;
		dots[(2 * (n + k)) + 1] = v;
	}
	zassert_equal(at_calib_run(dots, n + 4, grid, NG, &nominal, &cfg, TS_SCREEN_W, TS_SCREEN_H, &g2,
				   &rep2),
		      AT_CAL_OK);
	zassert_within(rep2.fit_rms_px, rep.fit_rms_px, 1e-9);
	for (int i = 0; i < 9; i++) {
		zassert_within(g2.to_cam.m[i], g.to_cam.m[i], 1e-9 * fmax(1.0, fabs(g.to_cam.m[i])));
	}

	int match[NG];

	zassert_equal(at_calib_order(dots, n + 4, grid, NG, &nominal, cfg.gate_px, match), NG);
	for (int i = 0; i < NG; i++) {
		zassert_true(match[i] < n, "grid point %d took a spurious dot", i);
	}
}

/* Missing dots: refused unless min_found allows it; the old calibration is kept. */
ZTEST(calib, test_missing_dots)
{
	at_calib_cfg cfg;
	at_calib_report rep;
	at_geom g, before;
	int n = make_dots(0.0, 4U);

	at_calib_cfg_default(&cfg);
	memset(&before, 0xA5, sizeof(before));
	g = before;
	/* Drop grid point 20 (not a corner): move the last dot into its place. */
	dots[2 * 20] = dots[2 * (n - 1)];
	dots[(2 * 20) + 1] = dots[(2 * (n - 1)) + 1];
	zassert_equal(at_calib_run(dots, n - 1, grid, NG, &nominal, &cfg, TS_SCREEN_W, TS_SCREEN_H, &g,
				   &rep),
		      AT_CAL_TOO_FEW);
	zassert_equal(rep.n_found, NG - 1);
	zassert_mem_equal(&g, &before, sizeof(g), "previous calibration kept");

	cfg.min_found = NG - 2;
	zassert_equal(at_calib_run(dots, n - 1, grid, NG, &nominal, &cfg, TS_SCREEN_W, TS_SCREEN_H, &g,
				   &rep),
		      AT_CAL_OK);

	/* Too few dots to order at all. */
	zassert_equal(at_calib_run(dots, 3, grid, NG, &nominal, &cfg, TS_SCREEN_W, TS_SCREEN_H, &g, &rep),
		      AT_CAL_ORDER);
	/* The four corners and two more: ordered, but too few for the fit (12 parameters). */
	static const int keep[6] = {0, 8, 45, 53, 20, 30};

	n = make_dots(0.0, 4U);
	for (int k = 0; k < 6; k++) {
		dots[2 * k] = dots[2 * keep[k]];
		dots[(2 * k) + 1] = dots[(2 * keep[k]) + 1];
	}
	cfg.min_found = 4;
	zassert_equal(at_calib_run(dots, 6, grid, NG, &nominal, &cfg, TS_SCREEN_W, TS_SCREEN_H, &g, &rep),
		      AT_CAL_TOO_FEW);
	zassert_equal(rep.n_found, 6);
}

/* A grid that does not fit the model (dots displaced by 3 px RMS): residual over P06, refused. */
ZTEST(calib, test_bad_grid_refused)
{
	at_calib_cfg cfg;
	at_calib_report rep;
	at_geom g, before;
	int n = make_dots(3.0, 5U);

	at_calib_cfg_default(&cfg);
	memset(&before, 0x5A, sizeof(before));
	g = before;
	zassert_equal(at_calib_run(dots, n, grid, NG, &nominal, &cfg, TS_SCREEN_W, TS_SCREEN_H, &g, &rep),
		      AT_CAL_RESIDUAL);
	TC_PRINT("bad grid: fit %.3f px, held-out %.3f px\n", rep.fit_rms_px, rep.holdout_rms_px);
	zassert_true(rep.fit_rms_px > 0.3);
	zassert_mem_equal(&g, &before, sizeof(g));
}

ZTEST(calib, test_no_holdout_and_iteration_limit)
{
	at_calib_cfg cfg;
	at_calib_report rep;
	at_geom g;
	int n = make_dots(0.02, 6U);

	at_calib_cfg_default(&cfg);
	cfg.holdout_every = 0;
	zassert_equal(at_calib_run(dots, n, grid, NG, &nominal, &cfg, TS_SCREEN_W, TS_SCREEN_H, &g, &rep),
		      AT_CAL_OK);
	zassert_equal(rep.n_holdout, 0);
	zassert_equal(rep.n_fit, NG);
	zassert_equal(rep.holdout_rms_px, 0.0);

	cfg.max_iter = 1;
	zassert_equal(at_calib_run(dots, n, grid, NG, &nominal, &cfg, TS_SCREEN_W, TS_SCREEN_H, &g, &rep),
		      AT_CAL_NO_CONVERGE);
}

/* A dot position that is not a number: refused, never a NaN geometry (fitted or held-out point). */
ZTEST(calib, test_nan_dot_refused)
{
	at_calib_cfg cfg;
	at_calib_report rep;
	at_geom g, before;
	int match[NG];
	int n = make_dots(0.02, 7U);

	at_calib_cfg_default(&cfg);
	zassert_equal(at_calib_order(dots, n, grid, NG, &nominal, cfg.gate_px, match), NG);
	memset(&before, 0x3C, sizeof(before));

	/* Grid point 22 is fitted: the cost is NaN, no step lowers it, and the gradient is not zero. */
	dots[2 * match[22]] = NAN;
	g = before;
	zassert_equal(at_calib_fit(dots, grid, match, NG, &nominal, &cfg, TS_SCREEN_W, TS_SCREEN_H, &g, &rep),
		      AT_CAL_NO_CONVERGE);
	zassert_mem_equal(&g, &before, sizeof(g));

	/* Grid point 24 is held out: the fit converges, the held-out residual is NaN. */
	n = make_dots(0.02, 7U);
	dots[2 * match[24]] = NAN;
	g = before;
	zassert_equal(at_calib_fit(dots, grid, match, NG, &nominal, &cfg, TS_SCREEN_W, TS_SCREEN_H, &g, &rep),
		      AT_CAL_RESIDUAL);
	zassert_mem_equal(&g, &before, sizeof(g));
}
```

## src/test_centroid.c
```c
/*
 * SPEC F03, §6.2: sub-pixel centroid, moments, SNR, saturation and the rim fit.
 */
#include <math.h>
#include <zephyr/ztest.h>

#include "aimtrk/centroid.h"
#include "test_util.h"

#define W 15
#define H 15

ZTEST_SUITE(centroid, NULL, NULL, NULL, NULL, NULL);

static uint8_t img[H * W];
static float sig[H * W];

static at_cwin whole(float bg)
{
	return (at_cwin){.px = img, .stride = W, .x0 = 100, .y0 = 200, .w = W, .h = H,
			 .mask = NULL, .bg = NULL, .bg_const = bg};
}

/* Weights 1 and 3 above background in one row: centroid 1.75 / 4 of the way, exactly. */
ZTEST(centroid, test_weighted_mean_exact)
{
	at_spot s;
	at_cwin win = whole(10.0F);

	memset(img, 10, sizeof(img));
	img[(7 * W) + 1] = 11;
	img[(7 * W) + 2] = 13;
	zassert_ok(at_centroid(&win, 1.0F, 255, &s));
	zassert_within(s.x, 100.0F + 1.75F, 1e-5F);
	zassert_within(s.y, 207.0F, 1e-5F);
	zassert_within(s.sum, 4.0F, 1e-5F);
	zassert_within(s.peak, 3.0F, 1e-5F);
	zassert_within(s.snr, 3.0F, 1e-5F);
	zassert_equal(s.flags, 0U);
	zassert_equal(s.x, s.cx);
}

/* Pixels outside the mask and pixels below background do not move the centroid. */
ZTEST(centroid, test_mask_and_clipping)
{
	static uint8_t mask[H * W];
	at_spot a, b;
	at_cwin win = whole(10.0F);

	memset(img, 10, sizeof(img));
	img[(5 * W) + 5] = 30;
	img[(5 * W) + 6] = 20;
	zassert_ok(at_centroid(&win, 1.0F, 255, &a));

	memset(mask, 0, sizeof(mask));
	for (int y = 4; y <= 6; y++) {
		for (int x = 4; x <= 7; x++) {
			mask[(y * W) + x] = 1;
		}
	}
	img[(12 * W) + 12] = 250; /* bright, outside the mask */
	img[(4 * W) + 7] = 0;     /* below background, inside the mask */
	win.mask = mask;
	zassert_ok(at_centroid(&win, 1.0F, 255, &b));
	zassert_within(b.x, a.x, 1e-5F);
	zassert_within(b.y, a.y, 1e-5F);
	zassert_within(b.sum, a.sum, 1e-5F);
}

ZTEST(centroid, test_no_signal)
{
	at_spot s = {.x = -1.0F};
	at_cwin win = whole(10.0F);

	memset(img, 9, sizeof(img));
	zassert_equal(at_centroid(&win, 1.0F, 255, &s), -1);
	zassert_equal(s.x, -1.0F, "spot must be left untouched");
}

/* The per-pixel background is used where given; the SNR uses a 0.5 DN noise floor. */
ZTEST(centroid, test_per_pixel_background_and_snr_floor)
{
	static float bg[H * W];
	at_spot s;
	at_cwin win = whole(0.0F);

	for (int i = 0; i < (H * W); i++) {
		bg[i] = (float)(i % W); /* a ramp across the window */
		img[i] = (uint8_t)(i % W);
	}
	img[(3 * W) + 9] = 9 + 6;
	win.bg = bg;
	zassert_ok(at_centroid(&win, 0.1F, 255, &s));
	zassert_within(s.x, 109.0F, 1e-5F);
	zassert_within(s.y, 203.0F, 1e-5F);
	zassert_within(s.snr, 12.0F, 1e-4F, "6 DN over the 0.5 DN floor");
}

/* Noise-free 8-bit spots over a grid of sub-pixel phases: bias from quantisation only. */
ZTEST(centroid, test_subpixel_phases)
{
	float worst = 0.0F;

	for (int i = 0; i <= 10; i++) {
		for (int j = 0; j <= 10; j++) {
			double u = 7.0 + ((i - 5) * 0.1);
			double v = 7.0 + ((j - 5) * 0.1);
			at_spot s;
			at_cwin win = whole(20.0F);

			tu_fill(sig, H * W, 20.0F);
			tu_spot(sig, W, H, u, v, 1.2, 1.2, 150.0);
			tu_quantise(sig, img, H * W, 0.0, NULL);
			zassert_ok(at_centroid(&win, 0.7F, 255, &s));
			float e = hypotf(s.x - (float)(100.0 + u), s.y - (float)(200.0 + v));

			worst = fmaxf(worst, e);
		}
	}
	TC_PRINT("worst phase error %.4f px\n", (double)worst);
	zassert_true(worst < 0.02F, "%f", (double)worst); /* a fifth of the 0.1 px budget */
}

/* Second moments give the spot's size along its axes. */
ZTEST(centroid, test_moments)
{
	at_spot s;
	at_cwin win = whole(10.0F);

	tu_fill(sig, H * W, 10.0F);
	tu_spot(sig, W, H, 7.2, 6.9, 2.0, 1.0, 200.0);
	tu_quantise(sig, img, H * W, 0.0, NULL);
	zassert_ok(at_centroid(&win, 0.7F, 255, &s));
	/* A pixel adds 1/12 px^2 of variance to a sampled Gaussian. */
	zassert_within(s.sig_major, sqrtf(4.0F + (1.0F / 12.0F)), 0.03F, "%f", (double)s.sig_major);
	zassert_within(s.sig_minor, sqrtf(1.0F + (1.0F / 12.0F)), 0.03F, "%f", (double)s.sig_minor);
	/* Integrated signal: within 1 % (8-bit rounding of the tails, the window edge). */
	zassert_within(s.sum, (float)(200.0 * 6.283185307179586 * 2.0), 25.0F, "%f", (double)s.sum);
}

/* Saturated spots: flagged, located by the rim fit, better than the clipped centroid. */
ZTEST(centroid, test_saturated_rim_fit)
{
	float worst_rim = 0.0F;
	float worst_plain = 0.0F;

	for (int i = 0; i <= 6; i++) {
		for (int j = 0; j <= 6; j++) {
			double u = 7.0 + ((i - 3) * 0.15);
			double v = 7.0 + ((j - 3) * 0.15);
			at_spot s;
			at_cwin win = whole(20.0F);

			tu_fill(sig, H * W, 20.0F);
			tu_spot(sig, W, H, u, v, 1.2, 1.2, 2000.0); /* 8x full scale */
			tu_quantise(sig, img, H * W, 0.0, NULL);
			zassert_ok(at_centroid(&win, 0.7F, 255, &s));
			zassert_equal(s.flags, AT_SPOT_SATURATED | AT_SPOT_RIM);
			zassert_true(s.n_sat >= 9U);
			worst_rim = fmaxf(worst_rim, hypotf(s.x - (float)(100.0 + u), s.y - (float)(200.0 + v)));
			worst_plain = fmaxf(worst_plain,
					    hypotf(s.cx - (float)(100.0 + u), s.cy - (float)(200.0 + v)));
		}
	}
	TC_PRINT("saturated: worst rim %.4f px, worst plain centroid %.4f px\n", (double)worst_rim,
		 (double)worst_plain);
	zassert_true(worst_rim < 0.02F, "%f", (double)worst_rim);
	zassert_true(worst_rim < worst_plain);
}

/* A spot saturated across the whole window has no rim: the centroid is kept and flagged. */
ZTEST(centroid, test_rim_failed)
{
	at_spot s;
	at_cwin win = whole(20.0F);

	memset(img, 255, sizeof(img));
	zassert_ok(at_centroid(&win, 0.7F, 255, &s));
	zassert_equal(s.flags, AT_SPOT_SATURATED | AT_SPOT_RIM_FAILED);
	zassert_within(s.x, 107.0F, 1e-5F);
	zassert_equal(s.n_sat, (uint16_t)(W * H));
}

/* The rim fit refuses data that is not a peak, and degenerate pixel sets. */
ZTEST(centroid, test_rim_rejects)
{
	float x = -1.0F, y = -1.0F;
	at_cwin win = whole(10.0F);

	/* A bowl: ln(s) convex. */
	for (int r = 0; r < H; r++) {
		for (int c = 0; c < W; c++) {
			int d2 = ((c - 7) * (c - 7)) + ((r - 7) * (r - 7));

			img[(r * W) + c] = (uint8_t)(20 + (d2 / 2));
		}
	}
	zassert_equal(at_centroid_rim(&win, 255, 2.0F, &x, &y), -1);

	/* All rim pixels in one row: the normal equations are singular. */
	memset(img, 10, sizeof(img));
	for (int c = 2; c < 13; c++) {
		img[(7 * W) + c] = (uint8_t)(40 + (10 * (c % 3)));
	}
	zassert_equal(at_centroid_rim(&win, 255, 2.0F, &x, &y), -1);

	/* Too few pixels. */
	memset(img, 10, sizeof(img));
	img[(7 * W) + 7] = 100;
	zassert_equal(at_centroid_rim(&win, 255, 2.0F, &x, &y), -1);
	zassert_equal(x, -1.0F);

	/* A peak far outside the window: the edge of a much larger spot. */
	tu_fill(sig, H * W, 10.0F);
	tu_spot(sig, W, H, 40.0, 7.0, 12.0, 12.0, 240.0);
	tu_quantise(sig, img, H * W, 0.0, NULL);
	zassert_equal(at_centroid_rim(&win, 255, 2.0F, &x, &y), -1);
}
```

## src/test_detect.c
```c
/*
 * SPEC F02, §6.1: background, noise estimate, threshold, runs and union-find,
 * rejection rules, background freeze under spots, table limits.
 */
#include <math.h>
#include <zephyr/ztest.h>

#include "aimtrk/detect.h"
#include "test_util.h"

#define W  64
#define H  64
#define NW 128 /* noise tests use a larger frame for more samples */
#define NH 128

static uint8_t mem[64 * 1024];
static at_detect det;
static at_detect_cfg cfg;
static float sig[NH * NW];
static uint8_t img[NH * NW];
static at_spot spots[8];

static void setup(uint16_t w, uint16_t h)
{
	at_detect_cfg_default(&cfg, w, h);
	cfg.max_runs = 1024; /* small test frames: keep the memory block small */
}

static void start(void)
{
	zassert_true(at_detect_mem_size(&cfg) <= sizeof(mem));
	zassert_ok(at_detect_init(&det, &cfg, mem, sizeof(mem)));
}

/* A flat frame at `level` (DN), learned as the background. */
static void flat_background(float level)
{
	tu_fill(sig, W * H, level);
	tu_quantise(sig, img, W * H, 0.0, NULL);
	at_detect_learn(&det, img, W);
}

static void before(void *f)
{
	ARG_UNUSED(f);
	setup(W, H);
	start();
}

ZTEST_SUITE(detect, NULL, NULL, before, NULL, NULL);

ZTEST(detect, test_config_and_memory)
{
	at_detect_cfg bad = cfg;

	bad.width = 66; /* not a multiple of the cell size */
	zassert_equal(at_detect_mem_size(&bad), 0U);
	zassert_equal(at_detect_init(&det, &bad, mem, sizeof(mem)), -1);
	bad = cfg;
	bad.max_extent = 255;
	zassert_equal(at_detect_mem_size(&bad), 0U);
	zassert_equal(at_detect_init(&det, &cfg, mem, at_detect_mem_size(&cfg) - 1U), -1);
	zassert_equal(at_detect_init(&det, &cfg, NULL, sizeof(mem)), -1);
	/* An unaligned block works: init aligns it. */
	zassert_ok(at_detect_init(&det, &cfg, mem + 3, sizeof(mem) - 3U));

	/* The full reference frame: memory is fixed, and modest. */
	at_detect_cfg full;

	at_detect_cfg_default(&full, 1280, 800);
	TC_PRINT("1280 x 800: %u bytes\n", (unsigned int)at_detect_mem_size(&full));
	zassert_true(at_detect_mem_size(&full) < (512U * 1024U));
}

ZTEST(detect, test_first_frame_learns_then_reset)
{
	tu_fill(sig, W * H, 20.0F);
	tu_spot(sig, W, H, 30.0, 30.0, 1.2, 1.2, 150.0);
	tu_quantise(sig, img, W * H, 0.0, NULL);
	zassert_equal(at_detect_frame(&det, img, W, spots, 8), 0);
	zassert_true(at_detect_get_stats(&det)->learning);

	flat_background(20.0F);
	tu_fill(sig, W * H, 20.0F);
	tu_spot(sig, W, H, 30.0, 30.0, 1.2, 1.2, 150.0);
	tu_quantise(sig, img, W * H, 0.0, NULL);
	zassert_equal(at_detect_frame(&det, img, W, spots, 8), 1);
	zassert_false(at_detect_get_stats(&det)->learning);

	at_detect_reset(&det);
	zassert_equal(at_detect_frame(&det, img, W, spots, 8), 0);
	zassert_true(at_detect_get_stats(&det)->learning);
}

/* MAD noise estimate on Gaussian noise (plus 1/12 DN^2 of quantisation). */
ZTEST(detect, test_noise_estimate)
{
	static const double levels[] = {1.0, 2.0, 5.0};
	uint32_t seed = 12345U;

	setup(NW, NH);
	start();
	for (size_t i = 0; i < ARRAY_SIZE(levels); i++) {
		tu_fill(sig, NW * NH, 40.0F);
		tu_quantise(sig, img, NW * NH, 0.0, NULL);
		at_detect_learn(&det, img, NW);
		tu_quantise(sig, img, NW * NH, levels[i], &seed);
		float s = at_detect_noise(&det, img, NW);
		double expect = sqrt((levels[i] * levels[i]) + (1.0 / 12.0));

		TC_PRINT("noise %.1f DN: estimate %.3f\n", levels[i], (double)s);
		/* MAD on 8-bit data: +9 % at 1 DN, within a few % from 2 DN up. */
		zassert_within((double)s, expect, 0.10 * expect);
	}
	/* Noise-free and flat: the estimate is below one DN (the quantisation floor). */
	tu_quantise(sig, img, NW * NH, 0.0, NULL);
	zassert_true(at_detect_noise(&det, img, NW) < 0.5F);
}

/* With little noise, t_min sets the threshold: pixel > background + 8 DN. */
ZTEST(detect, test_threshold_t_min)
{
	flat_background(20.0F);
	tu_quantise(sig, img, W * H, 0.0, NULL);
	for (int y = 20; y < 22; y++) {
		for (int x = 20; x < 22; x++) {
			img[(y * W) + x] = 28; /* = threshold: not detected */
		}
	}
	zassert_equal(at_detect_frame(&det, img, W, spots, 8), 0);
	zassert_equal(at_detect_get_stats(&det)->blobs, 0U);

	flat_background(20.0F);
	for (int y = 20; y < 22; y++) {
		for (int x = 20; x < 22; x++) {
			img[(y * W) + x] = 29;
		}
	}
	zassert_equal(at_detect_frame(&det, img, W, spots, 8), 1);
	zassert_within(spots[0].x, 20.5F, 1e-5F);
	zassert_within(spots[0].y, 20.5F, 1e-5F);
	zassert_equal(spots[0].area, 4U);
}

/* With noise, k_sigma * sigma sets it: a 15 DN spot is below 6 sigma at 3 DN noise, a 40 DN one above. */
ZTEST(detect, test_threshold_k_sigma)
{
	uint32_t seed = 99U;

	flat_background(30.0F);
	tu_fill(sig, W * H, 30.0F);
	tu_spot(sig, W, H, 20.3, 40.6, 1.2, 1.2, 15.0);
	tu_spot(sig, W, H, 44.2, 18.8, 1.2, 1.2, 40.0);
	tu_quantise(sig, img, W * H, 3.0, &seed);
	zassert_equal(at_detect_frame(&det, img, W, spots, 8), 1);
	zassert_within(at_detect_get_stats(&det)->sigma, 3.0F, 0.4F);
	zassert_within(spots[0].x, 44.2F, 0.3F);
	zassert_within(spots[0].y, 18.8F, 0.3F);
}

/* Label count for a binary pattern drawn at 100 DN on a 20 DN background. */
static uint32_t blobs_of(const char *const rows[], int nrows)
{
	flat_background(20.0F);
	for (int r = 0; r < nrows; r++) {
		for (int c = 0; rows[r][c] != '\0'; c++) {
			if (rows[r][c] == '#') {
				img[((10 + r) * W) + 10 + c] = 100;
			}
		}
	}
	(void)at_detect_frame(&det, img, W, spots, 8);
	return at_detect_get_stats(&det)->blobs;
}

ZTEST(detect, test_union_find_shapes)
{
	static const char *const u_shape[] = {
		"#....#",
		"#....#",
		"#....#",
		"######",
	};
	static const char *const w_shape[] = {
		"#...#...#",
		"#...#...#",
		".#.#.#.#.",
		"..#...#..",
		"...###...",
	};
	static const char *const diagonal[] = {
		"#....",
		".#...",
		"..#..",
		"...#.",
		"....#",
	};
	static const char *const anti_diagonal[] = {
		"....#",
		"...#.",
		"..#..",
		".#...",
		"#....",
	};
	static const char *const apart[] = {
		"##.##",
		"##.##",
	};
	static const char *const spiral[] = {
		"#######",
		"#.....#",
		"#.###.#",
		"#.#.#.#",
		"#.#...#",
		"#.#####",
	};

	zassert_equal(blobs_of(u_shape, 4), 1U);
	zassert_equal(blobs_of(w_shape, 5), 1U);
	zassert_equal(blobs_of(diagonal, 5), 1U);
	zassert_equal(blobs_of(anti_diagonal, 5), 1U);
	zassert_equal(blobs_of(apart, 2), 2U);
	zassert_equal(blobs_of(spiral, 6), 1U);
}

ZTEST(detect, test_rejection_rules)
{
	const at_detect_stats *st = at_detect_get_stats(&det);

	/* Two pixels: a hot pixel pair. */
	flat_background(20.0F);
	img[(30 * W) + 30] = 200;
	img[(30 * W) + 31] = 200;
	zassert_equal(at_detect_frame(&det, img, W, spots, 8), 0);
	zassert_equal(st->rejected[AT_REJ_SMALL], 1U);

	/* Wider than max_extent (24): a reflection. */
	flat_background(20.0F);
	memset(&img[30 * W + 5], 120, 30);
	zassert_equal(at_detect_frame(&det, img, W, spots, 8), 0);
	zassert_equal(st->rejected[AT_REJ_LARGE], 1U);

	/* 20 x 20: inside max_extent but more than max_area (300). */
	flat_background(20.0F);
	for (int y = 10; y < 30; y++) {
		memset(&img[(y * W) + 10], 120, 20);
	}
	zassert_equal(at_detect_frame(&det, img, W, spots, 8), 0);
	zassert_equal(st->rejected[AT_REJ_LARGE], 1U);

	/* A one-pixel line: a glint. */
	flat_background(20.0F);
	memset(&img[30 * W + 10], 120, 16);
	zassert_equal(at_detect_frame(&det, img, W, spots, 8), 0);
	zassert_equal(st->rejected[AT_REJ_ELONGATED], 1U);

	/* Above the threshold but below min_snr. */
	cfg.min_snr = 100.0F;
	start();
	flat_background(20.0F);
	tu_fill(sig, W * H, 20.0F);
	tu_spot(sig, W, H, 30.0, 30.0, 1.2, 1.2, 30.0);
	tu_quantise(sig, img, W * H, 0.0, NULL);
	zassert_equal(at_detect_frame(&det, img, W, spots, 8), 0);
	zassert_equal(st->rejected[AT_REJ_WEAK], 1U);
}

/* Spots come out in raster order of their first pixel, with their quality figures. */
ZTEST(detect, test_order_and_quality)
{
	flat_background(20.0F);
	tu_fill(sig, W * H, 20.0F);
	tu_spot(sig, W, H, 12.4, 40.7, 1.2, 1.2, 150.0);
	tu_spot(sig, W, H, 50.1, 15.2, 1.2, 1.2, 100.0);
	tu_quantise(sig, img, W * H, 0.0, NULL);
	zassert_equal(at_detect_frame(&det, img, W, spots, 8), 2);
	zassert_within(spots[0].y, 15.2F, 0.02F);
	zassert_within(spots[1].y, 40.7F, 0.02F);
	zassert_within(spots[1].x, 12.4F, 0.02F);
	zassert_true((spots[1].peak > 80.0F) && (spots[1].peak < 150.0F), "pixel-integrated peak %f",
		     (double)spots[1].peak);
	zassert_true(spots[1].area >= 9U);
	zassert_equal(spots[1].flags, 0U);
	zassert_within(spots[1].sig_major / spots[1].sig_minor, 1.0F, 0.1F);
}

/* A spot cut by the image border is still located, and flagged. */
ZTEST(detect, test_edge_flag)
{
	flat_background(20.0F);
	tu_fill(sig, W * H, 20.0F);
	tu_spot(sig, W, H, 0.4, 30.0, 1.2, 1.2, 150.0);
	tu_spot(sig, W, H, 32.0, 63.0, 1.2, 1.2, 150.0);
	tu_quantise(sig, img, W * H, 0.0, NULL);
	zassert_equal(at_detect_frame(&det, img, W, spots, 8), 2);
	for (int i = 0; i < 2; i++) {
		zassert_true((spots[i].flags & AT_SPOT_EDGE) != 0U);
	}
	/* Half the spot is outside: the centroid is pulled inward, which is why the flag exists. */
	TC_PRINT("edge spots: x %.3f (true 0.4), y %.3f (true 63.0)\n", (double)spots[0].x,
		 (double)spots[1].y);
	zassert_true((spots[0].x > 0.4F) && (spots[0].x < 1.5F));
	zassert_true((spots[1].y < 63.0F) && (spots[1].y > 61.5F));
}

/*
 * The background follows a slow change of the ambient level and is frozen
 * under a spot. The spot is there in every other frame, as an aim strobe with
 * two time slots (SPEC §6.5), so the cells under it still update in between.
 */
ZTEST(detect, test_background_tracks_and_freezes)
{
	const at_detect_stats *st = at_detect_get_stats(&det);
	float level = 20.0F;

	flat_background(level);
	for (int k = 0; k < 240; k++) {
		bool spot = (k % 2) == 0;

		if (k < 100) {
			level += 0.1F; /* 20 -> 30 DN in one second, then 1.4 s steady */
		}
		tu_fill(sig, W * H, level);
		if (spot) {
			tu_spot(sig, W, H, 30.3, 30.6, 1.2, 1.2, 150.0);
		}
		tu_quantise(sig, img, W * H, 0.0, NULL);
		zassert_equal(at_detect_frame(&det, img, W, spots, 8), spot ? 1 : 0, "frame %d", k);
	}
	/* Left: running-mean lag plus the truncation stall (under 1/16 DN). */
	zassert_within(at_detect_bg(&det, 5, 5), 30.0F, 0.1F, "%f", (double)at_detect_bg(&det, 5, 5));
	zassert_within(at_detect_bg(&det, 30, 30), 30.0F, 0.15F, "%f", (double)at_detect_bg(&det, 30, 30));
	zassert_within(st->bg_mean, 30.0F, 0.1F);

	/* One more frame with the spot, one DN brighter: only the cells away from it move. */
	float far = at_detect_bg(&det, 5, 5);
	float under = at_detect_bg(&det, 30, 30);

	tu_fill(sig, W * H, 31.0F);
	tu_spot(sig, W, H, 30.3, 30.6, 1.2, 1.2, 150.0);
	tu_quantise(sig, img, W * H, 0.0, NULL);
	zassert_equal(at_detect_frame(&det, img, W, spots, 8), 1);
	zassert_equal(at_detect_bg(&det, 30, 30), under, "frozen under the spot");
	zassert_true(at_detect_bg(&det, 5, 5) > far);
	zassert_true(st->frozen_cells >= 9U);
	zassert_within(spots[0].x, 30.3F, 0.05F);
}

ZTEST(detect, test_table_limits)
{
	static uint8_t three[W * H];
	const at_detect_stats *st = at_detect_get_stats(&det);

	tu_fill(sig, W * H, 20.0F);
	tu_spot(sig, W, H, 10.0, 10.0, 1.2, 1.2, 150.0);
	tu_spot(sig, W, H, 30.0, 30.0, 1.2, 1.2, 150.0);
	tu_spot(sig, W, H, 50.0, 50.0, 1.2, 1.2, 150.0);
	tu_quantise(sig, three, W * H, 0.0, NULL);

	/* Three spots, one spot slot: the first is returned, the overflow counted. */
	flat_background(20.0F);
	zassert_equal(at_detect_frame(&det, three, W, spots, 1), 1);
	zassert_equal(st->overflow, AT_OVF_SPOTS);
	zassert_within(spots[0].y, 10.0F, 0.05F);

	/* Two blob slots: the third blob is dropped. */
	cfg.max_blobs = 2;
	start();
	flat_background(20.0F);
	zassert_equal(at_detect_frame(&det, three, W, spots, 8), 2);
	zassert_equal(st->overflow, AT_OVF_BLOBS);

	/*
	 * Blobs too small to be a spot take no slot: still two slots, and a spot
	 * after forty 2-pixel specks in raster order is found (M4: a scene
	 * change about one threshold high breaks up into hundreds of them).
	 */
	static uint8_t specks[W * H];

	tu_fill(sig, W * H, 20.0F);
	for (int i = 0; i < 40; i++) {
		int x = 2 + ((i % 20) * 3);
		int y = 2 + ((i / 20) * 3);

		sig[(y * W) + x] = 60.0F;
		sig[(y * W) + x + 1] = 60.0F;
	}
	tu_spot(sig, W, H, 40.0, 40.0, 1.2, 1.2, 150.0);
	tu_quantise(sig, specks, W * H, 0.0, NULL);
	flat_background(20.0F);
	zassert_equal(at_detect_frame(&det, specks, W, spots, 8), 1);
	zassert_equal(st->overflow, 0U);
	zassert_equal(st->rejected[AT_REJ_SMALL], 40U);
	zassert_equal(st->blobs, 1U);
	zassert_within(spots[0].x, 40.0F, 0.05F);

	/* Four run slots: the scan stops adding runs. */
	cfg.max_blobs = 256;
	cfg.max_runs = 4;
	start();
	flat_background(20.0F);
	(void)at_detect_frame(&det, three, W, spots, 8);
	zassert_true((st->overflow & AT_OVF_RUNS) != 0U);
	zassert_equal(st->runs, 4U);
}

/* Random sub-pixel positions at the nominal spot (peak 150 DN) with 1 DN noise. */
ZTEST(detect, test_accuracy_nominal)
{
	uint32_t seed = 7U;
	double se = 0.0;
	int n = 200;

	for (int i = 0; i < n; i++) {
		double u = 31.5 + (tu_unif(&seed) - 0.5);
		double v = 31.5 + (tu_unif(&seed) - 0.5);

		flat_background(16.0F);
		tu_fill(sig, W * H, 16.0F);
		tu_spot(sig, W, H, u, v, 1.2, 1.2, 150.0);
		tu_quantise(sig, img, W * H, 1.0, &seed);
		zassert_equal(at_detect_frame(&det, img, W, spots, 8), 1);
		se += pow((double)spots[0].x - u, 2.0) + pow((double)spots[0].y - v, 2.0);
	}
	double rms = sqrt(se / n);

	TC_PRINT("nominal spot, 1 DN noise: radial RMS %.4f px\n", rms);
	zassert_true(rms < 0.05, "%f", rms);
}

/*
 * Step 6: a spot on top of a scene change (a projected shape moving in) merges
 * with it into one large blob; it is found inside, against the blob's level.
 */
ZTEST(detect, test_spot_on_scene_change)
{
	const at_detect_stats *st = at_detect_get_stats(&det);

	flat_background(20.0F);
	tu_fill(sig, W * H, 20.0F);
	for (int y = 8; y < 56; y++) {
		for (int x = 8; x < 56; x++) {
			sig[(y * W) + x] += 15.0F; /* the change: 15 DN, over the 8 DN threshold */
		}
	}
	tu_spot(sig, W, H, 30.4, 25.7, 1.2, 1.2, 150.0);
	tu_spot(sig, W, H, 44.2, 40.6, 1.2, 1.2, 100.0);
	tu_quantise(sig, img, W * H, 0.0, NULL);
	zassert_equal(at_detect_frame(&det, img, W, spots, 8), 2);
	zassert_equal(st->rejected[AT_REJ_LARGE], 1U);
	zassert_equal(st->recovered, 2U);
	for (int i = 0; i < 2; i++) {
		zassert_true((spots[i].flags & AT_SPOT_ON_CHANGE) != 0U);
	}
	zassert_within(spots[0].x, 30.4F, 0.05F, "%f", (double)spots[0].x);
	zassert_within(spots[0].y, 25.7F, 0.05F, "%f", (double)spots[0].y);
	zassert_within(spots[1].x, 44.2F, 0.05F, "%f", (double)spots[1].x);
	zassert_within(spots[1].y, 40.6F, 0.05F, "%f", (double)spots[1].y);

	/* The change alone gives no spot; neither does a saturated area (nothing above its level). */
	flat_background(20.0F);
	tu_fill(sig, W * H, 20.0F);
	for (int y = 8; y < 56; y++) {
		for (int x = 8; x < 56; x++) {
			sig[(y * W) + x] = ((x < 32) ? 35.0F : 300.0F);
		}
	}
	tu_quantise(sig, img, W * H, 0.0, NULL);
	zassert_equal(at_detect_frame(&det, img, W, spots, 8), 0);
	zassert_equal(st->recovered, 0U);
}
```

## src/test_geom.c
```c
/*
 * SPEC F04, §6.3: linear algebra helpers, lens distortion and its inverse,
 * homographies (normalised DLT), image <-> screen mapping, off-screen points.
 */
#include <math.h>
#include <zephyr/ztest.h>

#include "aimtrk/geom.h"
#include "aimtrk/linalg.h"
#include "test_scene.h"
#include "test_util.h"

ZTEST_SUITE(geom, NULL, NULL, NULL, NULL, NULL);

static const at_lens lens_ref = TS_LENS;

ZTEST(geom, test_solve)
{
	/* A random well-conditioned 12 x 12 system with a known solution. */
	uint32_t seed = 3U;
	double a[144], a0[144], x[12], b[12];

	for (int i = 0; i < 144; i++) {
		a[i] = tu_unif(&seed) - 0.5;
	}
	for (int i = 0; i < 12; i++) {
		a[(i * 12) + i] += 4.0;
		x[i] = tu_unif(&seed) * 10.0;
	}
	memcpy(a0, a, sizeof(a));
	for (int r = 0; r < 12; r++) {
		b[r] = 0.0;
		for (int c = 0; c < 12; c++) {
			b[r] += a0[(r * 12) + c] * x[c];
		}
	}
	zassert_true(at_solve(a, b, 12));
	for (int i = 0; i < 12; i++) {
		zassert_within(b[i], x[i], 1e-10);
	}
	/* Singular: two equal rows. */
	double s[9] = {1, 2, 3, 1, 2, 3, 0, 1, 1};
	double sb[3] = {1, 1, 1};

	zassert_false(at_solve(s, sb, 3));
	double z[4] = {0};
	double zb[2] = {1, 1};

	zassert_false(at_solve(z, zb, 2));
}

ZTEST(geom, test_sym_eig)
{
	uint32_t seed = 11U;
	double a[81], a0[81], ev[9], v[81];

	for (int r = 0; r < 9; r++) {
		for (int c = r; c < 9; c++) {
			a[(r * 9) + c] = tu_unif(&seed) - 0.5;
			a[(c * 9) + r] = a[(r * 9) + c];
		}
	}
	memcpy(a0, a, sizeof(a));
	zassert_true(at_sym_eig(a, 9, ev, v));
	for (int k = 0; k < 9; k++) {
		if (k > 0) {
			zassert_true(ev[k] >= ev[k - 1], "ascending");
		}
		for (int r = 0; r < 9; r++) {
			double av = 0.0;

			for (int c = 0; c < 9; c++) {
				av += a0[(r * 9) + c] * v[(c * 9) + k];
			}
			zassert_within(av, ev[k] * v[(r * 9) + k], 1e-10, "A v = lambda v");
		}
		for (int j = 0; j < 9; j++) {
			double d = 0.0;

			for (int r = 0; r < 9; r++) {
				d += v[(r * 9) + k] * v[(r * 9) + j];
			}
			zassert_within(d, (j == k) ? 1.0 : 0.0, 1e-10, "orthonormal");
		}
	}
}

/* Undistortion inverts distortion over the whole field (|x|, |y| <= 0.5, the corners of the frame). */
ZTEST(geom, test_distortion_round_trip)
{
	double worst = 0.0;

	for (int i = 0; i <= 20; i++) {
		for (int j = 0; j <= 20; j++) {
			double xn = -0.5 + (0.05 * i);
			double yn = -0.5 + (0.05 * j);
			double xd, yd, x2, y2;

			at_lens_distort(&lens_ref, xn, yn, &xd, &yd);
			zassert_true(at_lens_undistort(&lens_ref, xd, yd, &x2, &y2));
			worst = fmax(worst, hypot(x2 - xn, y2 - yn));
		}
	}
	zassert_true(worst < 1e-11, "%g", worst); /* Newton stops at 1e-12 in distorted coordinates */

	/* No distortion: identity. */
	at_lens plain = {.f = 1000.0};
	double xd, yd;

	at_lens_distort(&plain, 0.3, -0.2, &xd, &yd);
	zassert_within(xd, 0.3, 1e-15);
	zassert_within(yd, -0.2, 1e-15);

	/* Where the model folds over (strong barrel, far out) there is no inverse. */
	at_lens fold = {.f = 1000.0, .k1 = -1.0};

	zassert_false(at_lens_undistort(&fold, 2.0, 0.0, &xd, &yd));
}

static at_h33 h_ref(void)
{
	return (at_h33){{1.2, 0.1, 30.0, -0.05, 0.9, -12.0, 1e-4, -2e-4, 1.0}};
}

ZTEST(geom, test_homography_apply_invert)
{
	at_h33 h = h_ref(), inv;
	double x, y, x2, y2;

	zassert_true(at_h33_invert(&h, &inv));
	zassert_within(inv.m[8], 1.0, 1e-15);
	zassert_true(at_h33_apply(&h, 100.0, -50.0, &x, &y));
	zassert_true(at_h33_apply(&inv, x, y, &x2, &y2));
	zassert_within(x2, 100.0, 1e-9);
	zassert_within(y2, -50.0, 1e-9);

	at_h33 sing = {{1, 2, 3, 2, 4, 6, 0, 0, 1}};

	zassert_false(at_h33_invert(&sing, &inv));
	at_h33 zero = {{0}};

	zassert_false(at_h33_invert(&zero, &inv));
	/* A point on the line at infinity. */
	at_h33 p = {{1, 0, 0, 0, 1, 0, 1, 0, 0}};

	zassert_false(at_h33_apply(&p, 0.0, 5.0, &x, &y));
}

ZTEST(geom, test_dlt)
{
	at_h33 h = h_ref(), est;
	double src[2 * 20], dst[2 * 20];
	uint32_t seed = 5U;

	for (int i = 0; i < 20; i++) {
		src[2 * i] = (tu_unif(&seed) - 0.5) * 3000.0;
		src[(2 * i) + 1] = (tu_unif(&seed) - 0.5) * 1700.0;
		(void)at_h33_apply(&h, src[2 * i], src[(2 * i) + 1], &dst[2 * i], &dst[(2 * i) + 1]);
	}
	/* Exact from 4 points, least squares from 20. */
	for (int n = 4; n <= 20; n += 16) {
		zassert_ok(at_h33_dlt(src, dst, n, &est));
		for (int i = 0; i < 9; i++) {
			zassert_within(est.m[i], h.m[i], 1e-9 * fmax(1.0, fabs(h.m[i])), "n %d m[%d]", n, i);
		}
	}
	/* Degenerate: too few points, all points on one line. */
	zassert_equal(at_h33_dlt(src, dst, 3, &est), -1);
	for (int i = 0; i < 6; i++) {
		src[2 * i] = (double)i;
		src[(2 * i) + 1] = 2.0 * i;
	}
	zassert_equal(at_h33_dlt(src, dst, 6, &est), -1);
	for (int i = 0; i < 6; i++) {
		src[2 * i] = 7.0;
		src[(2 * i) + 1] = 7.0;
	}
	zassert_equal(at_h33_dlt(src, dst, 6, &est), -1, "all points equal");
}

ZTEST(geom, test_image_screen_mapping)
{
	at_geom g;
	at_h33 to_cam;
	double u, v, x, y;

	ts_camera_h(&to_cam);
	zassert_ok(at_geom_init(&g, &lens_ref, &to_cam, 3000.0, 1690.0));

	/* The screen centre is on the optical axis: the image centre. */
	zassert_true(at_geom_to_image(&g, 0.0, 0.0, &u, &v));
	zassert_within(u, 639.5, 1e-9);
	zassert_within(v, 399.5, 1e-9);

	/* Round trip over the screen and beyond its edge. */
	for (int i = -8; i <= 8; i++) {
		for (int j = -5; j <= 5; j++) {
			double px = 200.0 * i;
			double py = 180.0 * j;

			zassert_true(at_geom_to_image(&g, px, py, &u, &v));
			int st = at_geom_to_screen(&g, u, v, &x, &y);

			zassert_within(x, px, 1e-7);
			zassert_within(y, py, 1e-7);
			bool on = (fabs(px) <= 1500.0) && (fabs(py) <= 845.0);

			zassert_equal(st, on ? AT_GEOM_ON_SCREEN : AT_GEOM_OFF_SCREEN, "(%g, %g)", px, py);
		}
	}
	/* About 2.5 mm per pixel at the centre (SPEC §2a). */
	zassert_true(at_geom_to_image(&g, 0.0, 0.0, &u, &v));
	zassert_equal(at_geom_to_screen(&g, u + 1.0, v, &x, &y), AT_GEOM_ON_SCREEN);
	zassert_within(x, 2.54, 0.01);

	/* Invalid set-ups. */
	at_lens bad = lens_ref;

	bad.f = 0.0;
	zassert_equal(at_geom_init(&g, &bad, &to_cam, 3000.0, 1690.0), -1);
	at_h33 sing = {{0}};

	zassert_equal(at_geom_init(&g, &lens_ref, &sing, 3000.0, 1690.0), -1);

	/* A pixel the distortion model cannot invert. */
	at_lens fold = {.f = 100.0, .cx = 0.0, .cy = 0.0, .k1 = -1.0};

	zassert_ok(at_geom_init(&g, &fold, &to_cam, 3000.0, 1690.0));
	zassert_equal(at_geom_to_screen(&g, 200.0, 0.0, &x, &y), AT_GEOM_FAIL);
	/* A screen point the homography sends to infinity. */
	at_h33 inf = {{1, 0, 0, 0, 1, 0, 1, 0, 1}};

	zassert_ok(at_geom_init(&g, &lens_ref, &inf, 3000.0, 1690.0));
	zassert_false(at_geom_to_image(&g, -1.0, 3.0, &u, &v));
}
```

## src/test_proto.c
```c
/*
 * SPEC §7: every frame against protocol/tracker.dbc (bytes from cantools,
 * proto_vectors.h), and the saturation of positions and latency.
 */
#include <zephyr/ztest.h>

#include "aimtrk/proto.h"
#include "proto_vectors.h"

ZTEST_SUITE(proto, NULL, NULL, NULL, NULL, NULL);

ZTEST(proto, test_ids)
{
	zassert_equal(AT_CAN_ID(AT_FN_HIT, 1), 0x501);
	zassert_equal(AT_CAN_ID(AT_FN_AIM, 2), 0x582);
	zassert_equal(AT_CAN_ID(AT_FN_TRK_STATUS, AT_TRACKER_NODE), 0x67E);
	zassert_equal(AT_CAN_FN(0x101), AT_FN_SHOT_EVENT);
	zassert_equal(AT_CAN_NODE(0x183), 3);
}

ZTEST(proto, test_hit_against_dbc)
{
	uint8_t d[8];
	at_hit_msg ok = {.shot_no = 1234, .x_mm = 812.25F, .y_mm = -403.5F, .result = AT_HIT_OK,
			 .quality = 87, .latency_ms = 14.3F};
	at_hit_msg edge = {.shot_no = 65535, .x_mm = -2048.0F, .y_mm = 2047.75F,
			   .result = AT_HIT_OFF_SCREEN, .quality = 255, .latency_ms = 25.5F};
	at_hit_msg drop = {.shot_no = 7, .result = AT_HIT_DROPPED, .latency_ms = 0.1F};

	zassert_equal(at_proto_hit(&ok, d), 8);
	zassert_mem_equal(d, VEC_HIT_OK, 8);
	zassert_equal(at_proto_hit(&edge, d), 8);
	zassert_mem_equal(d, VEC_HIT_NEG_EDGE, 8);
	zassert_equal(at_proto_hit(&drop, d), 8);
	zassert_mem_equal(d, VEC_HIT_DROPPED, 8);

	/* Beyond the range: saturates to the edge frame's values. */
	at_hit_msg far = edge;

	far.x_mm = -5000.0F;
	far.y_mm = 9000.0F;
	far.latency_ms = 80.0F;
	zassert_equal(at_proto_hit(&far, d), 8);
	zassert_mem_equal(d, VEC_HIT_NEG_EDGE, 8);

	/* Round trip through the decoder. */
	at_hit_msg back;

	zassert_false(at_proto_hit_decode(d, 7, &back));
	zassert_true(at_proto_hit_decode(VEC_HIT_OK, 8, &back));
	zassert_equal(back.shot_no, 1234);
	zassert_within(back.x_mm, 812.25F, 1e-6F);
	zassert_within(back.y_mm, -403.5F, 1e-6F);
	zassert_equal(back.result, AT_HIT_OK);
	zassert_equal(back.quality, 87);
	zassert_within(back.latency_ms, 14.3F, 1e-5F);
}

ZTEST(proto, test_aim_and_status_against_dbc)
{
	uint8_t d[8];
	at_aim_msg aim = {.frame_seq = 40000, .x_mm = -1499.75F, .y_mm = 844.5F};
	at_status_msg st = {.fps = 99.9F, .dropped = 3, .worst_ms = 1.9F, .ambient = 16, .cal_age_h = 5,
			    .faults = AT_FAULT_FRAMES_DROPPED | AT_FAULT_NO_SYNC};

	zassert_equal(at_proto_aim(&aim, d), 6);
	zassert_mem_equal(d, VEC_AIM, 6);
	zassert_equal(at_proto_status(&st, d), 7);
	zassert_mem_equal(d, VEC_STATUS, 7);
}

ZTEST(proto, test_decode_s1_frames)
{
	uint32_t t;
	at_shot_event se;
	at_shot_detail sd;

	zassert_true(at_proto_sync(VEC_SYNC, 5, &t));
	zassert_equal(t, 4000000123U);
	zassert_false(at_proto_sync(VEC_SYNC, 8, &t));

	zassert_true(at_proto_shot_event(VEC_SHOT_EVENT, 8, &se));
	zassert_equal(se.shot_no, 513);
	zassert_equal(se.t_us, 3000000007U);
	zassert_equal(se.mode, 2);
	zassert_true(se.chambered);
	zassert_equal(se.rounds_left, 29);
	zassert_false(at_proto_shot_event(VEC_SHOT_EVENT, 5, &se));

	zassert_true(at_proto_shot_detail(VEC_SHOT_DETAIL, 8, &sd));
	zassert_equal(sd.shot_no, 513);
	zassert_equal(sd.takeup_ms, 120);
	zassert_equal(sd.squeeze_ms, 1020);
	zassert_equal(sd.jerk, 17);
	zassert_equal(sd.muzzle_rate, 9);
	zassert_equal(sd.cant, -12);
	zassert_equal(sd.flinch_x10, -13);
	zassert_false(at_proto_shot_detail(VEC_SHOT_DETAIL, 6, &sd));
}
```

## src/test_scene.h
```c
/*
 * The reference lane for the geometry tests (SPEC §2a, as sim/camsim.py):
 * a camera 0.75 m above the screen centre and 4 m out, looking at it, with
 * mild distortion; and the 9 x 6 calibration grid.
 */
#ifndef TEST_SCENE_H_
#define TEST_SCENE_H_

#include <math.h>

#include "aimtrk/geom.h"

#define TS_LENS {.f = 1600.0, .cx = 639.5, .cy = 399.5, .k1 = -0.08, .k2 = 0.01, .p1 = 0.0005, .p2 = -0.0003}
#define TS_SCREEN_W 3000.0
#define TS_SCREEN_H 1690.0
#define TS_COLS     9
#define TS_ROWS     6

/* Screen mm -> undistorted normalised camera coordinates of the reference camera. */
static inline void ts_camera_h(at_h33 *to_cam)
{
	double c[3] = {0.0, 750.0, 4000.0};
	double f[3] = {-c[0], -c[1], -c[2]};
	double nf = sqrt((f[0] * f[0]) + (f[1] * f[1]) + (f[2] * f[2]));

	for (int i = 0; i < 3; i++) {
		f[i] /= nf;
	}
	double r[3] = {-f[2], 0.0, f[0]}; /* f x (0, 1, 0) */
	double nr = sqrt((r[0] * r[0]) + (r[2] * r[2]));

	r[0] /= nr;
	r[2] /= nr;
	double d[3] = {(f[1] * r[2]) - (f[2] * r[1]), (f[2] * r[0]) - (f[0] * r[2]),
		       (f[0] * r[1]) - (f[1] * r[0])}; /* f x r */
	const double *rows[3] = {r, d, f};

	/* (X, Y, 0) -> R (P - C): columns R e_x, R e_y, -R C. */
	for (int i = 0; i < 3; i++) {
		to_cam->m[(i * 3) + 0] = rows[i][0];
		to_cam->m[(i * 3) + 1] = rows[i][1];
		to_cam->m[(i * 3) + 2] = -((rows[i][0] * c[0]) + (rows[i][1] * c[1]) + (rows[i][2] * c[2]));
	}
}

/* The calibration grid, row-major from the top-left, as camsim.calibration_grid(). */
static inline void ts_grid(double *grid)
{
	for (int r = 0; r < TS_ROWS; r++) {
		for (int c = 0; c < TS_COLS; c++) {
			grid[2 * ((r * TS_COLS) + c)] = -1350.0 + (2700.0 * c / (TS_COLS - 1));
			grid[(2 * ((r * TS_COLS) + c)) + 1] = 750.0 - (1500.0 * r / (TS_ROWS - 1));
		}
	}
}

#endif /* TEST_SCENE_H_ */
```

## src/test_timesync.c
```c
/*
 * SPEC F06: lane time from SYNC (offset, drift, wrap, restart, drift bound,
 * inverse, unwrapping a 32-bit stamp, late SYNCs held out, a real step taken).
 * The same scheme as the weapon firmware's timesync suite.
 */
#include <math.h>
#include <stdlib.h>
#include <zephyr/ztest.h>

#include "aimtrk/timesync.h"
#include "test_util.h"

ZTEST_SUITE(timesync, NULL, NULL, NULL, NULL, NULL);

/* SYNC every 10 ms; the tracker clock runs at (1 + ppm) against the lane, with reception jitter. */
static void feed(at_timesync *ts, int n, int64_t local0, int64_t lane0, double ppm, double jitter_us,
		 uint32_t *seed)
{
	for (int i = 0; i < n; i++) {
		int64_t lane = lane0 + ((int64_t)i * 10000);
		int64_t local = local0 + (int64_t)llround((double)(lane - lane0) * (1.0 + (ppm * 1e-6)));

		if (jitter_us > 0.0) {
			local += (int64_t)llround(fabs(tu_randn(seed)) * jitter_us);
		}
		at_ts_add(ts, local, (uint32_t)lane);
	}
}

ZTEST(timesync, test_offset_and_drift)
{
	at_timesync ts;
	uint32_t seed = 9U;

	at_ts_init(&ts);
	zassert_equal(at_ts_lane(&ts, 1234), 1234, "before SYNC: local time");
	/* Tracker clock 200 ppm fast, 5 us reception jitter (one-sided: frames arrive late). */
	feed(&ts, 100, 123456789, 50000000, 200.0, 5.0, &seed);
	TC_PRINT("drift %.1f ppm\n", at_ts_drift_ppm(&ts));
	zassert_within(at_ts_drift_ppm(&ts), -200.0, 15.0, "lane/local slope = 1/(1+200 ppm)");

	/* Lane time of a local instant 5 ms after the last SYNC: within 50 us. */
	int64_t lane_true = 50000000 + (99 * 10000) + 5000;
	int64_t local = 123456789 + llround((double)(lane_true - 50000000) * 1.0002);
	int64_t err = at_ts_lane(&ts, local) - lane_true;

	TC_PRINT("lane time error %lld us\n", (long long)err);
	zassert_true(llabs(err) <= 50, "%lld", (long long)err);
	/* The inverse round-trips. */
	zassert_true(llabs(at_ts_local(&ts, at_ts_lane(&ts, local)) - local) <= 1);
}

ZTEST(timesync, test_wrap_restart_and_bound)
{
	at_timesync ts;
	uint32_t seed = 4U;

	at_ts_init(&ts);
	/* Across the 32-bit wrap of the lane clock. */
	feed(&ts, 40, 1000000, 4294967296LL - 200000, 0.0, 0.0, &seed);
	zassert_within((double)at_ts_lane(&ts, 1000000 + 390000), 4294967296.0 + 190000.0, 2.0);
	zassert_equal(ts.resets, 0U);

	/* The lane restarts: lane time jumps back; the fit starts again. */
	feed(&ts, 5, 2000000, 1000, 0.0, 0.0, &seed);
	zassert_equal(ts.resets, 1U);

	/* A SYNC stream with an absurd slope (2 %): the drift is bounded to 500 ppm. */
	at_ts_init(&ts);
	feed(&ts, 32, 0, 0, 20000.0, 0.0, &seed);
	zassert_within(at_ts_drift_ppm(&ts), -500.0, 1e-6);
	at_ts_init(&ts);
	feed(&ts, 32, 0, 0, -20000.0, 0.0, &seed);
	zassert_within(at_ts_drift_ppm(&ts), 500.0, 1e-6);

	/* Before any SYNC the inverse is the identity too. */
	at_ts_init(&ts);
	zassert_equal(at_ts_local(&ts, 77), 77);
}

/* SYNC number i of a clean stream (tracker clock 40 ppm fast), received late_us late, lane time shifted by step_us. */
static void sync_i(at_timesync *ts, int i, int64_t late_us, int64_t step_us)
{
	int64_t lane = 50000000 + ((int64_t)i * 10000);
	int64_t local = 123456789 + llround((double)(lane - 50000000) * 1.00004);

	at_ts_add(ts, local + late_us, (uint32_t)(lane + step_us));
}

/* Lane-time error (us) of the estimate at the instant of SYNC number i, against the true lane time. */
static int64_t lane_err(const at_timesync *ts, int i, int64_t step_us)
{
	int64_t lane = 50000000 + ((int64_t)i * 10000);
	int64_t local = 123456789 + llround((double)(lane - 50000000) * 1.00004);

	return at_ts_lane(ts, local) - (lane + step_us);
}

/* One SYNC stamped 3 ms late (the receiver was busy): held out, the fit is not pulled. */
ZTEST(timesync, test_late_sync_rejected)
{
	at_timesync ts;

	at_ts_init(&ts);
	for (int i = 0; i < 40; i++) {
		sync_i(&ts, i, 0, 0);
	}
	sync_i(&ts, 40, 3000, 0);
	zassert_equal(ts.rejected, 1U);
	zassert_equal(ts.resets, 0U);
	zassert_true(llabs(lane_err(&ts, 41, 0)) <= 2, "%lld", (long long)lane_err(&ts, 41, 0));
	for (int i = 41; i < 50; i++) {
		sync_i(&ts, i, 0, 0);
	}
	zassert_equal(ts.rejected, 1U, "clean SYNCs after it are taken");
	zassert_equal(ts.n_pend, 0U);
	zassert_true(llabs(lane_err(&ts, 50, 0)) <= 2);

	/* Late SYNCs in a row that disagree with each other (1-9 ms): still outliers, not a step. */
	sync_i(&ts, 50, 1000, 0);
	sync_i(&ts, 51, 3000, 0);
	sync_i(&ts, 52, 6000, 0);
	sync_i(&ts, 53, 9000, 0);
	sync_i(&ts, 54, 12000, 0);
	zassert_equal(ts.resets, 0U);
	zassert_equal(ts.rejected, 6U);
	zassert_true(llabs(lane_err(&ts, 55, 0)) <= 2);
}

/* The lane time steps by 2 ms and stays there: taken after AT_TS_STEP_N SYNCs in a row agree. */
ZTEST(timesync, test_step_accepted_after_n)
{
	at_timesync ts;

	at_ts_init(&ts);
	for (int i = 0; i < 40; i++) {
		sync_i(&ts, i, 0, 0);
	}
	for (int i = 40; i < (40 + (int)AT_TS_STEP_N - 1); i++) {
		sync_i(&ts, i, 0, 2000);
		zassert_equal(ts.resets, 0U, "SYNC %d after the step: held out", i - 39);
		zassert_true(llabs(lane_err(&ts, i, 0)) <= 2, "still the old lane time");
	}
	sync_i(&ts, 40 + (int)AT_TS_STEP_N - 1, 0, 2000);
	zassert_equal(ts.resets, 1U, "step taken");
	zassert_equal(ts.rejected, AT_TS_STEP_N);
	int i_next = 40 + (int)AT_TS_STEP_N;

	zassert_true(llabs(lane_err(&ts, i_next, 2000)) <= 2, "%lld", (long long)lane_err(&ts, i_next, 2000));
	for (int i = i_next; i < (i_next + 10); i++) {
		sync_i(&ts, i, 0, 2000);
	}
	zassert_equal(ts.resets, 1U);
	zassert_equal(ts.rejected, AT_TS_STEP_N);
}

ZTEST(timesync, test_unwrap_near)
{
	int64_t near = (3LL << 32) + 100;

	zassert_equal(at_ts_unwrap_near(50, near), (3LL << 32) + 50);
	/* A stamp just before the wrap, seen just after it. */
	zassert_equal(at_ts_unwrap_near(0xFFFFFF00U, near), (3LL << 32) - 256);
	/* A stamp just after the wrap, seen just before it. */
	zassert_equal(at_ts_unwrap_near(10, (4LL << 32) - 20), (4LL << 32) + 10);
	zassert_equal(at_ts_unwrap_near(5, -100), 5);
}
```
